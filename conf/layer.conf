## conf/layer.conf
```bitbake
LAYERVERSION_meta-gumstix-dspbridge = "1"

LAYERDEPENDS_meta-gumstix-dspbridge = "meta-gumstix"

# We have a conf directory, append to BBPATH
BBPATH .= ":${LAYERDIR}"

# We have a recipes directory, add to BBFILES
BBFILES += "${LAYERDIR}/recipes-*/*/*.bb ${LAYERDIR}/recipes-*/*/*.bbappend"

# Override TI_PKG_DIR in local.conf copied to build/conf/local.conf
TI_PKG_DIR := "${TOPDIR}/../ti_pkgs"

TI_DEPOT_DIR := "/opt/ti-tools"

BBFILE_COLLECTIONS += "meta-gumstix-dspbridge"
BBFILE_PATTERN_meta-gumstix-dspbridge := "^${LAYERDIR}/"
BBFILE_PRIORITY_meta-gumstix-dspbridge = "8"

MACHINE ?= "overo"


# Set a few Preferred Providers that aren't specified elsewhere
PREFERRED_PROVIDER_ntp = "ntp"
PREFERRED_PROVIDER_udev = "systemd"
PREFERRED_PROVIDER_jpeg = "libjpeg-turbo"
PREFERRED_PROVIDER_jpeg-native = "libjpeg-turbo-native"

DEPENDS_binutils-cross += "texinfo-native"
DEPENDS_gcc-cross += "texinfo-native"
DEPENDS_gcc-cross-initial += "texinfo-native"

PREFERRED_PROVIDER_linux-gumstix = "linux-gumstix-dspbridge"
PREFERRED_PROVIDER_virtual/kernel = "linux-gumstix-dspbridge"
PREFERRED_VERSION_linux-gumstix-dspbridge = "3.7"

PREFERRED_VERSION_ti-xdctools-cross = "3.10.02"
#PREFERRED_VERSION_ti-xdctools-cross = "3.16.05.41"
#PREFERRED_VERSION_ti-xdctools-cross = "3.20.08.88"
#PREFERRED_VERSION_ti-xdctools-cross = "3.25.05.94"
PREFERRED_VERSION_ti-dspbios-cross = "5.21.03.12"
#PREFERRED_VERSION_ti-dspbios-cross = "5.33.04"
#PREFERRED_VERSION_ti-dspbios-cross = "5.41.00.06"
PREFERRED_VERSION_ti-cgt6x-cross = "6.0.7"
#PREFERRED_VERSION_ti-cgt6x-cross = "6.1.23"
PREFERRED_VERSION_ti-cgt55-cross = "4.4.1"
PREFERRED_VERSION_ti-dsplib-c64x+-cross = "3.1.1.1"
PREFERRED_VERSION_ti-framework-components-cross = "2.25.03.07"
PREFERRED_VERSION_ti-iqmath-c64x+-cross = "2.01.04.00"


TI_DEPOT_DIR := "/opt/ti-tools"

EXTRA_TOOLS ?= " \
    rsync \
    "

TI_TOOLS ?= " \
    ti-dspbridge \
    ti-dspbridge-mpusamples \
    ti-dspbridge-dsp \
    ti-dspbridge-cross \
    "

TI_SDK ?= " \
    "

EXTRA_SDK_LIBS ?= " \
"

EXTRA_IMAGE_INSTALL += " \
    ${EXTRA_TOOLS} \
    ${TI_TOOLS} \
    ${TI_SDK} \
    ${EXTRA_SDK_LIBS} \
    "

SOURCE_MIRROR_URL ?= "file://${TI_PKG_DIR}"
```
